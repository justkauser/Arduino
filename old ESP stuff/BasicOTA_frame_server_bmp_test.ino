#include <WiFi.h>
#include <HTTPClient.h>
#include <ESPmDNS.h>
#include <WiFiUdp.h>
#include <ArduinoOTA.h>
#include <Wire.h>
#include <Adafruit_GFX.h>
#include <Adafruit_SSD1306.h>
#include <ArduinoJson.h>

#define ARRAY_SIZE 1024  // Größe des Arrays entsprechend der Textdatei
#define SCREEN_WIDTH 128 // OLED display width, in pixels
#define SCREEN_HEIGHT 64 // OLED display height, in pixels

// Declaration for an SSD1306 display connected to I2C (SDA, SCL pins)
Adafruit_SSD1306 display(SCREEN_WIDTH, SCREEN_HEIGHT, &Wire, -1);

const char* ssid = "";
const char* password = "";

//variabls for blinking an LED with Millis
const int led = 2; // ESP32 Pin to which onboard LED is connected
unsigned long previousMillis = 0;
unsigned long previousTime  = 0;
 // will store last time LED was updated
const long interval = 1000;  // interval at which to blink (milliseconds)
int ledState = LOW;  // ledState used to set the LED

const char* serverUrl = "http://192.168.178.36/test/frametest2.php?name=frame2&position=6";


//nsigned char frameData[ARRAY_SIZE];

int framecount  = 100;
int buffer_fc = 76;
int frame = 0;

// BMP Header-Struktur
#pragma pack(push, 1)
typedef struct {
  uint16_t signature;
  uint32_t fileSize;
  uint32_t reserved;
  uint32_t imageDataOffset;
  uint32_t headerSize;
  int32_t width;
  int32_t height;
  uint16_t planes;
  uint16_t bitDepth;
  uint32_t compression;
  uint32_t imageSize;
  int32_t horizontalResolution;
  int32_t verticalResolution;
  uint32_t colorsUsed;
  uint32_t colorsImportant;
} BMPHeader;
#pragma pack(pop)

void setup() {




pinMode(led, OUTPUT);  
  Serial.begin(115200);
  Serial.println("Booting");
  WiFi.mode(WIFI_STA);
  WiFi.begin(ssid, password);
  while (WiFi.waitForConnectResult() != WL_CONNECTED) {
    Serial.println("Connection Failed! Rebooting...");
    delay(5000);
    ESP.restart();
  }

  // Port defaults to 3232
  // ArduinoOTA.setPort(3232);

  // Hostname defaults to esp3232-[MAC]
  // ArduinoOTA.setHostname("myesp32");

  // No authentication by default
  // ArduinoOTA.setPassword("admin");

  // Password can be set with it's md5 value as well
  // MD5(admin) = 21232f297a57a5a743894a0e4a801fc3
  // ArduinoOTA.setPasswordHash("21232f297a57a5a743894a0e4a801fc3");

  ArduinoOTA
    .onStart([]() {
      String type;
      if (ArduinoOTA.getCommand() == U_FLASH)
        type = "sketch";
      else // U_SPIFFS
        type = "filesystem";

      // NOTE: if updating SPIFFS this would be the place to unmount SPIFFS using SPIFFS.end()
      Serial.println("Start updating " + type);
    })
    .onEnd([]() {
      Serial.println("\nEnd");
    })
    .onProgress([](unsigned int progress, unsigned int total) {
      Serial.printf("Progress: %u%%\r", (progress / (total / 100)));
    })
    .onError([](ota_error_t error) {
      Serial.printf("Error[%u]: ", error);
      if (error == OTA_AUTH_ERROR) Serial.println("Auth Failed");
      else if (error == OTA_BEGIN_ERROR) Serial.println("Begin Failed");
      else if (error == OTA_CONNECT_ERROR) Serial.println("Connect Failed");
      else if (error == OTA_RECEIVE_ERROR) Serial.println("Receive Failed");
      else if (error == OTA_END_ERROR) Serial.println("End Failed");
    });

  ArduinoOTA.begin();

  Serial.println("Ready");
  Serial.print("IP address: ");
  Serial.println(WiFi.localIP());

  

   display.begin(SSD1306_SWITCHCAPVCC, 0x3C); // Adresse des OLED-Displays anpassen
  display.clearDisplay();
  display.setTextColor(WHITE);
  display.setTextSize(1);
  // Display static text
  //display.println("Hello Word, love you <3 ");
  // Draw bitmap on the screen
  //display.drawBitmap(0, 0, image_data_Saraarray, 128, 64, 1);
  display.display(); 
  
  //writeBufferinFrames();
   //readFileAndSetVariable(5,2);
//ServerLog("test%20Space");
}



int xx=40;
int yy=0;


void loop() {
  ArduinoOTA.handle();  


unsigned long currentTime = millis();  // Aktuelle Zeit abrufen

  // Überprüfen, ob die gewünschte Verzögerungszeit vergangen ist
  if (currentTime - previousTime >= 50) {
    previousTime = currentTime;  // Aktuelle Zeit als vorherigen Zeitpunkt speichern

    loadBMP();
    
  }
  //ServerLog("Starte%20Test%20JSON:Frames");
  //for (int i = 0; i < 26; i++) {
  //JSONtest(i);}
 // ServerLog("Ende%20Test%20JSON:Frames");

  

  //loop to blink without delay
  unsigned long currentMillis = millis();
  if (currentMillis - previousMillis >= interval) {
  // save the last time you blinked the LED
  previousMillis = currentMillis;
  // if the LED is off turn it on and vice-versa:
  ledState = not(ledState);
  // set the LED with the ledState of the variable:
  digitalWrite(led,  ledState);
  //display.startscrolldiagright(0x00, 0x07);
  }
}



void readFileAndSetVariable(int pos, int frame) {
  if (WiFi.status() == WL_CONNECTED) {
    HTTPClient http;
    //int pos = 6; int frame = 2;
   String dynServerUrl = "http://192.168.178.36/test/frametest2.php?name=frame" + String(frame) + "&position=" + String(pos);
   http.begin(dynServerUrl);


    // Sende den HTTP-GET-Request an den Server
    int httpResponseCode = http.GET();

    if (httpResponseCode == HTTP_CODE_OK) {
      // Erhalte den Inhalt der Textdatei als String
      String fileContent = http.getString();
      //display.clearDisplay();
      //display.setCursor(0, 0);
      //display.println(fileContent);
      //display.println(String(previousTime/1000/60)+"min");
      //display.display();
      // Überprüfe, ob der Inhalt "helloworld" lautet
      //if (fileContent == "helloworld") {
        //variable = true;
       // memcpy(frame0, frame1, 1024); 
        //frame0=frame1;
        //Serial.println("Variable set to true");
      //} else {
        //variable = false;
       // Serial.println("Variable set to false");
      //}
    }
    else {
      Serial.print("Error reading file. HTTP response code: ");
      Serial.println(httpResponseCode);
    }

    http.end();
  }
}

void ServerLog(String Log) {
  if (WiFi.status() == WL_CONNECTED) {
    HTTPClient http;
    //int pos = 6; int frame = 2;
   String dynServerUrl = "http://192.168.178.36/test/save_logs.php?log=" + Log;
   http.begin(dynServerUrl);


    // Sende den HTTP-GET-Request an den Server
    int httpResponseCode = http.GET();

    
    http.end();
  }
}

void JSONtest(int frame){

if (WiFi.status() == WL_CONNECTED){
        HTTPClient http;
        http.begin("http://192.168.178.36/test/frametest3.php?name=frame" + String(frame));
        int httpCode = http.GET();
        if (httpCode == HTTP_CODE_OK) {
            String payload = http.getString();
            Serial.println(payload);
            StaticJsonDocument<1024> doc;
            deserializeJson(doc, payload);
            JsonArray arr = doc.as<JsonArray>();
            unsigned char PROGMEM frame0[] = {0x00,0x00,0x00,0x00,0x00,0x00,0x00,0x00,0x00,0x00,0x00,0x00,0x00,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0x00,0x00};

           // transferJsonArrayToProgmem(arr, frame0);
            
  

            display.clearDisplay();
            display.drawBitmap(0, 0, frame0, 128, 64, 1); 
            display.display(); 
          
        }
        http.end();
    }
    }

const int FRAME_SIZE = 1024;

void loadBMP() {
  // Überprüfe, ob Daten vom Server empfangen wurden
  if (WiFi.status() == WL_CONNECTED) {
    HTTPClient http;
    //String url = "http://" + String(serverIP) + "/test/frametest3.php?name=frame" + String(frame);

    // Fordere die Bilddaten an
    http.begin("http://192.168.178.36/test/send_bmp.php");
    int httpCode = http.GET();
    
    if (httpCode == HTTP_CODE_OK) {
      WiFiClient* stream = http.getStreamPtr();

       //Überspringe den BMP-Header (54 Bytes)
      for (int i = 0; i < 34; i++) {
        stream->read();
      }

      // Zeichne das Bild auf dem Display
      for (int y = 0; y < SCREEN_HEIGHT; y++) {
        for (int x = 0; x < SCREEN_WIDTH / 8; x++) {
          uint8_t byte = stream->read();
          for (int bit = 0; bit < 8; bit++) {
            bool pixelState = bitRead(byte, 7 - bit);
            display.drawPixel(x * 8 + bit,70- y, pixelState ? WHITE : BLACK);
          }
        }
      }
      display.display();
    }

    // Schließe die HTTP-Verbindung
    http.end();
  }

  // Führe weitere Aufgaben aus
  // ...
}
